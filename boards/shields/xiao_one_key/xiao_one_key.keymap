#include <behaviors.dtsi>
#include <dt-bindings/zmk/keys.h>

/ {
    keymap {
        compatible = "zmk,keymap";

        default_layer {
            bindings = <
                &kp C_PREV  &kp C_STOP  &kp C_NEXT
            >;
        };
    };
};