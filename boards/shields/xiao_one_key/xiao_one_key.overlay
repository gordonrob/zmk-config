/ {
    chosen {
        zmk,kscan = &default_kscan;
    };

    default_kscan: kscan {
        compatible = "zmk,kscan-gpio-direct";
        label = "default_kscan";

        input-gpios = 
            <&xiao_d 9 (GPIO_ACTIVE_LOW | GPIO_PULL_UP)>,
            <&xiao_d 7 (GPIO_ACTIVE_LOW | GPIO_PULL_UP)>,
            <&xiao_d 4 (GPIO_ACTIVE_LOW | GPIO_PULL_UP)>;
    };
};